## sdkconfig.defaults
```kconfig
# flash
CONFIG_ESPTOOLPY_FLASHSIZE_4MB=y
CONFIG_PARTITION_TABLE_CUSTOM=y

# FATFS
CONFIG_FATFS_LFN_HEAP=y

# LVGL
CONFIG_LV_USE_FS_POSIX=y
CONFIG_LV_FS_POSIX_LETTER=83
CONFIG_LV_FS_POSIX_PATH="/sdcard"
CONFIG_LV_FS_POSIX_CACHE_SIZE=4096
CONFIG_LV_CONF_SKIP=n

# image
CONFIG_LV_USE_TJPGD=y
CONFIG_LV_FONT_MONTSERRAT_14=y
CONFIG_LV_FONT_MONTSERRAT_16=y
CONFIG_LV_FONT_MONTSERRAT_20=y
CONFIG_LV_FONT_MONTSERRAT_28=y
```
