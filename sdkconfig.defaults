## sdkconfig.defaults
```kconfig
#flash
CONFIG_ESPTOOLPY_FLASHSIZE_4MB=y
CONFIG_PARTITION_TABLE_CUSTOM=y
CONFIG_PARTITION_TABLE_CUSTOM_FILENAME="partitions.csv"

#FATFS
CONFIG_FATFS_LFN_HEAP=y

#LVGL
CONFIG_LV_USE_FS_POSIX=y
CONFIG_LV_FS_POSIX_LETTER=83
CONFIG_LV_FS_POSIX_PATH="/sdcard"
CONFIG_LV_FS_POSIX_CACHE_SIZE=4096
CONFIG_LV_CONF_SKIP=n

#image
CONFIG_LV_USE_TJPGD=y
UI_FONT_BLACK_METAL_14=y
UI_FONT_BLACK_METAL_16=y
UI_FONT_BLACK_METAL_20=y
```
